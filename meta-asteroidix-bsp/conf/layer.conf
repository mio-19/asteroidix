## meta-asteroidix-bsp/conf/layer.conf
```bitbake
BBPATH .= ":${LAYERDIR}"
BBFILES += "${LAYERDIR}/recipes-*/*/*.bb ${LAYERDIR}/recipes-*/*/*.bbappend"

BBFILE_COLLECTIONS += "asteroidix-bsp"
BBFILE_PATTERN_asteroidix-bsp = "^${LAYERDIR}/"
BBFILE_PRIORITY_asteroidix-bsp = "95"

LAYERDEPENDS_asteroidix-bsp = "core"
LAYERSERIES_COMPAT_asteroidix-bsp = "whinlatter"
```

## meta-asteroidix-custom/conf/layer.conf
```bitbake
BBPATH .= ":${LAYERDIR}"
BBFILES += "${LAYERDIR}/recipes-*/*/*.bb ${LAYERDIR}/recipes-*/*/*.bbappend"

BBFILE_COLLECTIONS += "asteroidix-custom"
BBFILE_PATTERN_asteroidix-custom = "^${LAYERDIR}/"
BBFILE_PRIORITY_asteroidix-custom = "99"

LAYERDEPENDS_asteroidix-custom = "core"
LAYERSERIES_COMPAT_asteroidix-custom = "whinlatter"
```

## meta-asteroidix-nightly/conf/layer.conf
```bitbake
BBPATH .= ":${LAYERDIR}"
BBFILES += "${LAYERDIR}/recipes-*/*/*.bb ${LAYERDIR}/recipes-*/*/*.bbappend"

BBFILE_COLLECTIONS += "asteroidix-nightly"
BBFILE_PATTERN_asteroidix-nightly = "^${LAYERDIR}/"
BBFILE_PRIORITY_asteroidix-nightly = "99"

LAYERDEPENDS_asteroidix-nightly = "core asteroidix"
LAYERSERIES_COMPAT_asteroidix-nightly = "whinlatter"

MACHINE_HAS_WLAN:hoki = "true"
```

## meta-asteroidix-sandbox/conf/layer.conf
```bitbake
BBPATH .= ":${LAYERDIR}"
BBFILES += "${LAYERDIR}/recipes-*/*/*.bb ${LAYERDIR}/recipes-*/*/*.bbappend"

BBFILE_COLLECTIONS += "asteroidix-sandbox"
BBFILE_PATTERN_asteroidix-sandbox = "^${LAYERDIR}/"
BBFILE_PRIORITY_asteroidix-sandbox = "99"

LAYERDEPENDS_asteroidix-sandbox = "core"
LAYERSERIES_COMPAT_asteroidix-sandbox = "walnascar whinlatter"
```
