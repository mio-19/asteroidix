## meta-asteroidix-local/conf/layer.conf
```bitbake
BBPATH .= ":${LAYERDIR}"
BBFILES += "${LAYERDIR}/recipes-*/*/*.bbappend"

BBFILE_COLLECTIONS += "asteroidix"
BBFILE_PATTERN_asteroidix = "^${LAYERDIR}/"
BBFILE_PRIORITY_asteroidix = "99"

LAYERDEPENDS_asteroidix = "core"
LAYERSERIES_COMPAT_asteroidix = "walnascar"
```
